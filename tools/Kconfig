## tools/Kconfig
```kconfig
menu "功能模块选择"
    config ENABLE_WIFI
        bool "启用 WiFi 模块"
        default y

    config ENABLE_CAMERA
        bool "启用 Camera 模块"
        default y

    config ENABLE_ZLMEDIA
        bool "启用 ZLMedia 模块"
        depends on ENABLE_CAMERA
        default y

    config ENABLE_GPS
        bool "启用 GPS 模块"
        default n

    config ENABLE_IMU
        bool "启用 IMU 模块"
        default n
endmenu
```

## tools/defconfig
```kconfig
CONFIG_ENABLE_WIFI=y
CONFIG_ENABLE_CAMERA=y
CONFIG_ENABLE_ZLMEDIA=y
# CONFIG_ENABLE_GPS is not set
# CONFIG_ENABLE_IMU is not set
```
